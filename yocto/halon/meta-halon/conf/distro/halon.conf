## yocto/openhalon/meta-platform-openhalon-genericx86-64/conf/layer.conf
```bitbake
# We have a conf and classes directory, add to BBPATH
BBPATH := "${LAYERDIR}:${BBPATH}"

# We have a packages directory, add to BBFILES
BBFILES := "${BBFILES} ${LAYERDIR}/recipes-*/*/*.bb \
            ${LAYERDIR}/recipes-*/*/*.bbappend"

BBFILE_COLLECTIONS += "openhalon-genericx86-64"
BBFILE_PATTERN_openhalon-genericx86-64 := "^${LAYERDIR}/"
BBFILE_PRIORITY_openhalon-genericx86-64 = "11"
```

## yocto/openhalon/meta-platform-openhalon-genericx86-64/conf/machine/genericx86-64.conf
```bitbake
DEFAULTTUNE ?= "core2-64"
require conf/machine/include/tune-core2.inc
include conf/machine/include/x86-base.inc

PREFERRED_PROVIDER_virtual/kernel ?= "linux-yocto"
PREFERRED_VERSION_linux-yocto ?= "3.14%"

MACHINE_EXTRA_RRECOMMENDS += "linux-firmware v86d eee-acpi-scripts genericx86-64-networking openvswitch"

GLIBC_ADDONS = "nptl"

IMAGE_FSTYPES = "cpio.gz tar.gz"

MACHINE_FEATURES = "pcbios usbhost acpi pci ext2 ext3 x86 vfat serial"
MACHINE_ESSENTIAL_EXTRA_RDEPENDS += " \
  packagegroup-halon-min \
  packagegroup-halon-min-debug \
  packagegroup-halon-base \
  packagegroup-halon-core \
"

# Enable ssh server and allow login root with no password
EXTRA_IMAGE_FEATURES = "vagrant-tweaks debug-tweaks ssh-server-dropbear"
```

## yocto/openswitch/meta-distro-openswitch/conf/distro/include/openswitch-uninative.inc
```bitbake
#
# This include points at uninative tarballs generated and maintained
# by the OpenSwitch Project. These file can be included by distros if they
# want to use/maintain a unified sstate feed for native/cross artefacts
# rather than the feeds having native/cross artefacts which are specific
# to the distro running on the build machine.
#

# This version of the uninative tools is generated with the same recipes as
# the yocto project, plus patches requires by OpenSwitch:
#
# - Update patchelf tools to newer version to avoid issues with go-generated binaries

UNINATIVE_URL = "http://archive.openswitch.net/uninative/0.95/"
UNINATIVE_CHECKSUM[x86_64] ?= "0e1496dc728e43803b9589c1d76eff735bfba12253414234d3459d4f0f46c665"
```

## yocto/openswitch/meta-distro-openswitch/conf/distro/openswitch.conf
```bitbake
DISTRO = "openswitch"
DISTRO_NAME = "OpenSwitch"
DISTRO_SHORTNAME = "ops"
DISTRO_VERSION = "0.3.0-rc0"
DISTRO_CODENAME = "dill"
SDK_VENDOR = "-openswitchsdk"
SDK_VERSION := "${@'${DISTRO_VERSION}'.replace('snapshot-${DATE}','snapshot')}"

MAINTAINER = "OpenSwitch Team"

TARGET_VENDOR = "-openswitch"

LOCALCONF_VERSION = "1"

PREFERRED_VERSION_linux-ops ?= "3.8%"

# We dont want the kernel on the final images
RDEPENDS_kernel-base = ""

SDK_NAME = "${DISTRO}-${TCLIBC}-${SDK_ARCH}-${TUNE_PKGARCH}"
SDKPATH = "/opt/${DISTRO}/${MACHINE}/${SDK_VERSION}"

#EXTRAOPKGCONFIG = "poky-feed-config-opkg"

DISTRO_EXTRA_RDEPENDS += " packagegroup-ops"
DISTRO_EXTRA_RRECOMMENDS += "gdb-cross-${TARGET_ARCH}"

DISTRO_FEATURES_LIBC = "ipv4 ipv6 libc-backtrace libc-big-macros libc-bsd libc-cxx-tests libc-catgets libc-charsets libc-crypt \
					libc-crypt-ufc libc-db-aliases libc-envz libc-fcvt libc-fmtmsg libc-fstab libc-ftraverse \
					libc-getlogin libc-idn libc-inet-anl libc-libm libc-libm-big libc-locales libc-locale-code \
					libc-memusage libc-nis libc-nsswitch libc-rcmd libc-rtld-debug libc-spawn libc-streams libc-sunrpc \
					libc-utmp libc-utmpx libc-wordexp libc-posix-clang-wchar libc-posix-regexp libc-posix-regexp-glibc \
					libc-posix-wchar-io"
DISTRO_FEATURES_LIBC_virtclass-nativesdk = "${DISTRO_FEATURES_LIBC_DEFAULT}"

OPENSWITCH_DEFAULT_DISTRO_FEATURES = " largefile multiarch systemd pam"

# We remove zeroconf from the distro features, otherwise we pull a big deal of dependencies for packagegroup-base
# We also remove bluetooth, wifi, nfs, 3g, because they are automatically pulled by packagegroup-base against your will...
DISTRO_FEATURES_DEFAULT = "alsa argp ext2 irda largefile pcmcia usbgadget usbhost xattr nfs pci"

DISTRO_FEATURES ?= "${DISTRO_FEATURES_DEFAULT} ${DISTRO_FEATURES_LIBC} ${OPENSWITCH_DEFAULT_DISTRO_FEATURES}"

VIRTUAL-RUNTIME_init_manager = "systemd"
DISTRO_FEATURES_BACKFILL_CONSIDERED = "sysvinit"

IMAGE_LINGUAS ?= "en-us en-gb"
LIMIT_BUILT_LOCALES = "POSIX en_US"
ENABLE_BINARY_LOCALE_GENERATION ?= "0"

POKYQEMUDEPS = "${@bb.utils.contains("INCOMPATIBLE_LICENSE", "GPLv3", "", "packagegroup-core-device-devel",d)}"
DISTRO_EXTRA_RDEPENDS_append_qemuarm = " ${POKYQEMUDEPS}"
DISTRO_EXTRA_RDEPENDS_append_qemuarm64 = " ${POKYQEMUDEPS}"
DISTRO_EXTRA_RDEPENDS_append_qemumips = " ${POKYQEMUDEPS}"
DISTRO_EXTRA_RDEPENDS_append_qemuppc = " ${POKYQEMUDEPS}"
DISTRO_EXTRA_RDEPENDS_append_qemux86 = " ${POKYQEMUDEPS}"
DISTRO_EXTRA_RDEPENDS_append_qemux86-64 = " ${POKYQEMUDEPS}"

TCLIBCAPPEND = ""

QEMU_TARGETS ?= "arm aarch64 i386 ppc x86_64"

PREMIRRORS ??= "\
bzr://.*/.*   http://downloads.yoctoproject.org/mirror/sources/ \n \
cvs://.*/.*   http://downloads.yoctoproject.org/mirror/sources/ \n \
git://.*/.*   http://downloads.yoctoproject.org/mirror/sources/ \n \
gitsm://.*/.* http://downloads.yoctoproject.org/mirror/sources/ \n \
hg://.*/.*    http://downloads.yoctoproject.org/mirror/sources/ \n \
osc://.*/.*   http://downloads.yoctoproject.org/mirror/sources/ \n \
p4://.*/.*    http://downloads.yoctoproject.org/mirror/sources/ \n \
svk://.*/.*   http://downloads.yoctoproject.org/mirror/sources/ \n \
svn://.*/.*   http://downloads.yoctoproject.org/mirror/sources/ \n"

MIRRORS =+ "\
ftp://.*/.*      http://downloads.yoctoproject.org/mirror/sources/ \n \
http://.*/.*     http://downloads.yoctoproject.org/mirror/sources/ \n \
https://.*/.*    http://downloads.yoctoproject.org/mirror/sources/ \n"

# The CONNECTIVITY_CHECK_URI's are used to test whether we can succesfully
# fetch from the network (and warn you if not). To disable the test set
# the variable to be empty.
# Git example url: git://git.yoctoproject.org/yocto-firewall-test;protocol=git;rev=HEAD

CONNECTIVITY_CHECK_URIS ?= " \
             https://eula-downloads.yoctoproject.org/index.php \
             http://bugzilla.yoctoproject.org/report.cgi"

SANITY_TESTED_DISTROS ?= " \
            poky-1.7 \n \
            poky-1.8 \n \
            Ubuntu-14.04 \n \
            Ubuntu-14.10 \n \
            Fedora-21 \n \
            CentOS-6.* \n \
            CentOS-7.* \n \
            Debian-7.* \n \
            Debian-8.* \n \
            openSUSE-13.2 \n \
            "

# Default hash policy for distro
BB_SIGNATURE_HANDLER ?= 'OEBasicHash'
#
# OELAYOUT_ABI allows us to notify users when the format of TMPDIR changes in
# an incompatible way. Such changes should usually be detailed in the commit
# that breaks the format and have been previously discussed on the mailing list
# with general agreement from the core team.
#
OELAYOUT_ABI = "10"

# add poky sanity bbclass
INHERIT += "poky-sanity"

# QA check settings - a little stricter than the OE-Core defaults
WARN_TO_ERROR_QA = "already-stripped compile-host-path install-host-path \
                    installed-vs-shipped ldflags pn-overrides rpaths staticdev \
                    useless-rpaths"
WARN_QA_remove = "${WARN_TO_ERROR_QA}"
ERROR_QA_append = " ${WARN_TO_ERROR_QA}"

PACKAGECONFIG_append_pn-systemd = "resolved"
```

## yocto/openswitch/meta-foss-openswitch/conf/layer.conf
```bitbake
# We have a conf and classes directory, add to BBPATH
BBPATH := "${LAYERDIR}:${BBPATH}"

# We have a packages directory, add to BBFILES
BBFILES := "${BBFILES} ${LAYERDIR}/recipes-*/*/*.bb \
            ${LAYERDIR}/recipes-*/*/*.bbappend"

BBFILE_COLLECTIONS += "foss-openswitch"
BBFILE_PATTERN_foss-openswitch := "^${LAYERDIR}/"
BBFILE_PRIORITY_foss-openswitch = "7"

LICENSE_PATH += "${LAYERDIR}/licenses"
```

## yocto/openswitch/meta-platform-openswitch-appliance/conf/machine/appliance.conf
```bitbake
DEFAULTTUNE ?= "core2-64"
require conf/machine/include/tune-core2.inc
include conf/machine/include/x86-base.inc

PREFERRED_PROVIDER_virtual/kernel ?= "linux-yocto"
PREFERRED_VERSION_linux-yocto ?= "3.14%"

MACHINE_EXTRA_RRECOMMENDS += "linux-firmware v86d eee-acpi-scripts"

GLIBC_ADDONS = "nptl"

IMAGE_FSTYPES = "cpio.gz tar.gz"

MACHINE_FEATURES = "pcbios usbhost acpi pci ext2 ext3 x86 vfat serial ops-container"
MACHINE_ESSENTIAL_EXTRA_RDEPENDS += " \
  packagegroup-ops-min \
  packagegroup-ops-min-debug \
  packagegroup-ops-base \
  packagegroup-ops-core \
"

PREFERRED_PROVIDER_virtual/ops-switchd-switch-api-plugin ?=  "${@bb.utils.contains("IMAGE_FEATURES", "ops-p4", "ops-switchd-p4switch-plugin", "ops-switchd-container-plugin", d)}"

# Allow login root with no password and enable vagrant tweaks
EXTRA_IMAGE_FEATURES += "vagrant-tweaks debug-tweaks"

IMAGE_FEATURES[validitems] += "ops-p4"
```

## yocto/openswitch/meta-platform-openswitch-as5712/conf/machine/as5712.conf
```bitbake
DEFAULTTUNE ?= "core2-64"
require conf/machine/include/tune-core2.inc
include conf/machine/include/x86-base.inc

PREFERRED_PROVIDER_virtual/kernel ?= "linux-ops"
PREFERRED_VERSION_linux-ops ?= "3.9%"

GLIBC_ADDONS = "nptl"

IMAGE_FSTYPES = "cpio.gz tar.gz"

MACHINE_FEATURES = "pcbios usbhost acpi serial pci ext2 ext3 x86 vfat broadcom \
                    ops-kdump "
MACHINE_ESSENTIAL_EXTRA_RDEPENDS += " \
  packagegroup-ops-min \
  packagegroup-ops-min-debug \
  packagegroup-ops-base \
"

# Allow login root with no password
EXTRA_IMAGE_FEATURES +="debug-tweaks"

PREFERRED_PROVIDER_virtual/ops-switchd-switch-api-plugin ?= "ops-switchd-opennsl-plugin"

MACHINE_EXTRA_RRECOMMENDS += "dmidecode"
```

## yocto/openswitch/meta-platform-openswitch-as6712/conf/layer.conf
```bitbake
# We have a conf and classes directory, add to BBPATH
BBPATH := "${LAYERDIR}:${BBPATH}"

# We have a packages directory, add to BBFILES
BBFILES := "${BBFILES} ${LAYERDIR}/recipes-*/*/*.bb \
            ${LAYERDIR}/recipes-*/*/*.bbappend"

BBFILE_COLLECTIONS += "openswitch-as6712"
BBFILE_PATTERN_openswitch-as6712 := "^${LAYERDIR}/"
BBFILE_PRIORITY_openswitch-as6712 = "11"
```

## yocto/openswitch/meta-platform-openswitch-as6712/conf/machine/as6712.conf
```bitbake
DEFAULTTUNE ?= "core2-64"
require conf/machine/include/tune-core2.inc
include conf/machine/include/x86-base.inc

PREFERRED_PROVIDER_virtual/kernel ?= "linux-ops"
PREFERRED_VERSION_linux-ops ?= "3.9%"

GLIBC_ADDONS = "nptl"

IMAGE_FSTYPES = "cpio.gz tar.gz"

MACHINE_FEATURES = "pcbios usbhost acpi serial pci ext2 ext3 x86 vfat broadcom"
MACHINE_ESSENTIAL_EXTRA_RDEPENDS += " \
  packagegroup-ops-min \
  packagegroup-ops-min-debug \
  packagegroup-ops-base \
"

# Allow login root with no password
EXTRA_IMAGE_FEATURES +="debug-tweaks"

MACHINE_EXTRA_RRECOMMENDS += "dmidecode as6712-networking"
```

## yocto/openswitch/meta-platform-openswitch-genericx86-64/conf/layer.conf
```bitbake
# We have a conf and classes directory, add to BBPATH
BBPATH := "${LAYERDIR}:${BBPATH}"

# We have a packages directory, add to BBFILES
BBFILES := "${BBFILES} ${LAYERDIR}/recipes-*/*/*.bb \
            ${LAYERDIR}/recipes-*/*/*.bbappend"

BBFILE_COLLECTIONS += "openswitch-genericx86-64"
BBFILE_PATTERN_openswitch-genericx86-64 := "^${LAYERDIR}/"
BBFILE_PRIORITY_openswitch-genericx86-64 = "11"
```

## yocto/openswitch/meta-platform-openswitch-genericx86-64/conf/machine/genericx86-64.conf
```bitbake
DEFAULTTUNE ?= "core2-64"
require conf/machine/include/tune-core2.inc
include conf/machine/include/x86-base.inc

IMAGE_FEATURES[validitems] += "ops-p4"

PREFERRED_PROVIDER_virtual/kernel ?= "linux-yocto"
PREFERRED_VERSION_linux-yocto ?= "3.14%"

MACHINE_EXTRA_RRECOMMENDS += "linux-firmware v86d eee-acpi-scripts"

GLIBC_ADDONS = "nptl"

IMAGE_FSTYPES = "cpio.gz tar.gz"

MACHINE_FEATURES = "pcbios usbhost acpi pci ext2 ext3 x86 vfat serial \
    ops-container ops-container-coredump"
MACHINE_ESSENTIAL_EXTRA_RDEPENDS += " \
  packagegroup-ops-min \
  packagegroup-ops-min-debug \
  packagegroup-ops-base \
  packagegroup-ops-core \
"

# Why IMAGE_FEATURES and not MACHINE_FEATURES? Because MACHINE_FEATURES
# is unconditionally set above, while IMAGE_FEATURES is the combination
# of IMAGE_FEATURES specified elsewhere and IMAGE_EXTRA_FEATURES
# specified in local.conf

MACHINE_ESSENTIAL_EXTRA_RDEPENDS += \
  "${@bb.utils.contains("IMAGE_FEATURES", "ops-p4", "packagegroup-ops-p4", "", d)}"

MACHINE_ESSENTIAL_EXTRA_RDEPENDS += \
  "${@bb.utils.contains("MACHINE_FEATURES", "ops-container", "packagegroup-ops-container", "", d)}"

PREFERRED_PROVIDER_virtual/ops-switchd-switch-api-plugin ?= \
  "${@bb.utils.contains("IMAGE_FEATURES", "ops-p4", "ops-switchd-p4switch-plugin", "ops-switchd-container-plugin", d)}"

# Allow login root with no password and enable vagrant tweaks
EXTRA_IMAGE_FEATURES += "vagrant-tweaks debug-tweaks"
```
