## yocto/halon/meta-halon/conf/distro/halon.conf
```bitbake
DISTRO = "halon"
DISTRO_NAME = "OpenHalon"
DISTRO_VERSION = "1.0.0"
DISTRO_CODENAME = ""
SDK_VENDOR = "-openhalonsdk"
SDK_VERSION := "${@'${DISTRO_VERSION}'}"

MAINTAINER = "OpenHalon Team"

TARGET_VENDOR = "-openhalon"

LOCALCONF_VERSION = "1"
LAYER_CONF_VERSION ?= "6"

PREFERRED_VERSION_linux-halon ?= "3.8%"

# We dont want the kernel on the final images
RDEPENDS_kernel-base = ""

SDK_NAME = "${DISTRO}-${TCLIBC}-${SDK_ARCH}-${TUNE_PKGARCH}"
SDKPATH = "/opt/${DISTRO}/${MACHINE}/${SDK_VERSION}"

#EXTRAOPKGCONFIG = "poky-feed-config-opkg"

DISTRO_EXTRA_RDEPENDS += " packagegroup-halon"
DISTRO_EXTRA_RRECOMMENDS += "gdb-cross"

DISTRO_FEATURES_LIBC = "ipv4 ipv6 libc-backtrace libc-big-macros libc-bsd libc-cxx-tests libc-catgets libc-charsets libc-crypt \
					libc-crypt-ufc libc-db-aliases libc-envz libc-fcvt libc-fmtmsg libc-fstab libc-ftraverse \
					libc-getlogin libc-idn libc-inet-anl libc-libm libc-libm-big libc-locales libc-locale-code \
					libc-memusage libc-nis libc-nsswitch libc-rcmd libc-rtld-debug libc-spawn libc-streams libc-sunrpc \
					libc-utmp libc-utmpx libc-wordexp libc-posix-clang-wchar libc-posix-regexp libc-posix-regexp-glibc \
					libc-posix-wchar-io"
DISTRO_FEATURES_LIBC_virtclass-nativesdk = "${DISTRO_FEATURES_LIBC_DEFAULT}"

HALON_DEFAULT_DISTRO_FEATURES = " largefile multiarch systemd"

# We remove zeroconf from the distro features, otherwise we pull a big deal of dependencies for packagegroup-base
# We also remove bluetooth, wifi, nfs, 3g, because they are automatically pulled by packagegroup-base against your will...
DISTRO_FEATURES_DEFAULT = "alsa argp ext2 irda largefile pcmcia usbgadget usbhost xattr nfs pci"

DISTRO_FEATURES ?= "${DISTRO_FEATURES_DEFAULT} ${DISTRO_FEATURES_LIBC} ${HALON_DEFAULT_DISTRO_FEATURES}"

VIRTUAL-RUNTIME_init_manager = "systemd"
DISTRO_FEATURES_BACKFILL_CONSIDERED = "sysvinit"

IMAGE_LINGUAS ?= "en-us en-gb"
LIMIT_BUILT_LOCALES = "POSIX en_US"
ENABLE_BINARY_LOCALE_GENERATION ?= "0"

POKYQEMUDEPS = "${@base_contains("INCOMPATIBLE_LICENSE", "GPLv3", "", "qemu-config",d)}"
DISTRO_EXTRA_RDEPENDS_append_qemuarm = " ${POKYQEMUDEPS}"
DISTRO_EXTRA_RDEPENDS_append_qemumips = " ${POKYQEMUDEPS}"
DISTRO_EXTRA_RDEPENDS_append_qemuppc = " ${POKYQEMUDEPS}"
DISTRO_EXTRA_RDEPENDS_append_qemux86 = " ${POKYQEMUDEPS}"
DISTRO_EXTRA_RDEPENDS_append_qemux86-64 = " ${POKYQEMUDEPS}"

TCLIBCAPPEND = ""

QEMU_TARGETS ?= "arm ppc"

PREMIRRORS ??= "\
bzr://.*/.*   http://downloads.yoctoproject.org/mirror/sources/ \n \
cvs://.*/.*   http://downloads.yoctoproject.org/mirror/sources/ \n \
git://.*/.*   http://downloads.yoctoproject.org/mirror/sources/ \n \
hg://.*/.*    http://downloads.yoctoproject.org/mirror/sources/ \n \
osc://.*/.*   http://downloads.yoctoproject.org/mirror/sources/ \n \
p4://.*/.*    http://downloads.yoctoproject.org/mirror/sources/ \n \
svk://.*/.*   http://downloads.yoctoproject.org/mirror/sources/ \n \
svn://.*/.*   http://downloads.yoctoproject.org/mirror/sources/ \n"

MIRRORS =+ "\
ftp://.*/.*      http://downloads.yoctoproject.org/mirror/sources/ \n \
http://.*/.*     http://downloads.yoctoproject.org/mirror/sources/ \n \
https://.*/.*    http://downloads.yoctoproject.org/mirror/sources/ \n"

# The CONNECTIVITY_CHECK_URI's are used to test whether we can succesfully
# fetch from the network (and warn you if not). To disable the test set
# the variable to be empty.
# Git example url: git://git.yoctoproject.org/yocto-firewall-test;protocol=git;rev=HEAD

CONNECTIVITY_CHECK_URIS ?= " \
             https://eula-downloads.yoctoproject.org/index.php \
             http://bugzilla.yoctoproject.org/report.cgi"

SANITY_TESTED_DISTROS ?= " \
            Poky-1.4 \n \
            Poky-1.5 \n \
            Poky-1.6 \n \
            Ubuntu-12.04 \n \
            Ubuntu-13.04 \n \
            Ubuntu-13.10 \n \
            Ubuntu-14.04 \n \
            Fedora-19 \n \
            Fedora-20 \n \
            CentOS-6.4 \n \
            CentOS-6.5 \n \
            Debian-7.0 \n \
            Debian-7.1 \n \
            Debian-7.2 \n \
            Debian-7.3 \n \
            Debian-7.4 \n \
            Debian-7.5 \n \
            Debian-7.6 \n \
            Debian-7.8 \n \
            SUSE-LINUX-12.2 \n \
            openSUSE-project-12.3 \n \
            openSUSE-project-13.1 \n \
            "

# Default hash policy for distro
BB_SIGNATURE_HANDLER ?= 'OEBasicHash'
#
# OELAYOUT_ABI allows us to notify users when the format of TMPDIR changes in 
# an incompatible way. Such changes should usually be detailed in the commit
# that breaks the format and have been previously discussed on the mailing list 
# with general agreement from the core team.
#
OELAYOUT_ABI = "8"

# add poky sanity bbclass
INHERIT += "poky-sanity"

# QA check settings - a little stricter than the OE-Core defaults
WARN_QA = "textrel files-invalid incompatible-license xorg-driver-abi libdir \
           unknown-configure-option"
ERROR_QA = "dev-so debug-deps dev-deps debug-files arch pkgconfig la perms \
            useless-rpaths rpaths staticdev ldflags pkgvarcheck already-stripped \
            compile-host-path dep-cmp installed-vs-shipped install-host-path \
            packages-list perm-config perm-line perm-link pkgv-undefined \
            pn-overrides split-strip var-undefined version-going-backwards"

# We use rsyslog instead of busybox's syslog
BAD_RECOMMENDATIONS += "busybox-syslog busybox-syslog-systemd"
```

## yocto/halon/meta-hp/conf/layer.conf
```bitbake
# We have a conf and classes directory, add to BBPATH
BBPATH := "${LAYERDIR}:${BBPATH}"

# We have a packages directory, add to BBFILES
BBFILES := "${BBFILES} ${LAYERDIR}/recipes-*/*/*.bb \
            ${LAYERDIR}/recipes-*/*/*.bbappend"

BBFILE_COLLECTIONS += "hp"
BBFILE_PATTERN_hp := "^${LAYERDIR}/"
BBFILE_PRIORITY_hp = "7"

LICENSE_PATH += "${LAYERDIR}/licenses"
```

## yocto/libreswitch/meta-distro-libreswitch/conf/distro/include/libreswitch-uninative.inc
```bitbake
#
# This include points at uninative tarballs generated and maintained
# by the LibreSwitch Project. These file can be included by distros if they
# want to use/maintain a unified sstate feed for native/cross artefacts
# rather than the feeds having native/cross artefacts which are specific
# to the distro running on the build machine.
#

# This version of the uninative tools is generated with the same recipes as
# the yocto project, plus patches requires by LibreSwitch:
#
# - Update patchelf tools to newer version to avoid issues with go-generated binaries

UNINATIVE_URL = "https://yocto.libreswitch.org/downloads/uninative/0e1496dc728e43803b9589c1d76eff735bfba12253414234d3459d4f0f46c665/"
UNINATIVE_CHECKSUM[x86_64] ?= "0e1496dc728e43803b9589c1d76eff735bfba12253414234d3459d4f0f46c665"
```

## yocto/libreswitch/meta-distro-libreswitch/conf/distro/libreswitch.conf
```bitbake
DISTRO = "libreswitch"
DISTRO_NAME = "LibreSwitch"
DISTRO_SHORTNAME = "lbs"
DISTRO_VERSION = "1.0.0"
DISTRO_CODENAME = "epazote"
SDK_VENDOR = "-libreswitchsdk"
SDK_VERSION := "${@'${DISTRO_VERSION}'.replace('snapshot-${DATE}','snapshot')}"

LBS_REPO_HOSTNAME ?= "github.com"
LBS_REPO_PATH ?= "libreswitch"
LBS_REPO_BASE_URL ?= "git://${LBS_REPO_HOSTNAME}/${LBS_REPO_PATH}"
LBS_REPO_PROTOCOL ?= "https"
LBS_REPO_BRANCH ?= "master"

MAINTAINER = "LibreSwitch Team"

TARGET_VENDOR = "-libreswitch"

LOCALCONF_VERSION = "1"

DISTRO_VERSION[vardepsexclude] = "DATE"
SDK_VERSION[vardepsexclude] = "DATE"

PREFERRED_PROVIDER_virtual/kernel ?= "linux-yocto"
PREFERRED_VERSION_linux-yocto ?= "4.4%"

SDK_NAME = "${DISTRO}-${TCLIBC}-${SDK_ARCH}-${IMAGE_BASENAME}-${TUNE_PKGARCH}"
SDKPATH = "/opt/${DISTRO}/${MACHINE}/${SDK_VERSION}"

#EXTRAOPKGCONFIG = "poky-feed-config-opkg"

DISTRO_EXTRA_RDEPENDS += " packagegroup-ops"
DISTRO_EXTRA_RRECOMMENDS += "gdb-cross-${TARGET_ARCH}"

DISTRO_FEATURES_LIBC = "ipv4 ipv6 libc-backtrace libc-big-macros libc-bsd libc-cxx-tests libc-catgets libc-charsets libc-crypt \
					libc-crypt-ufc libc-db-aliases libc-envz libc-fcvt libc-fmtmsg libc-fstab libc-ftraverse \
					libc-getlogin libc-idn libc-inet-anl libc-libm libc-libm-big libc-locales libc-locale-code \
					libc-memusage libc-nis libc-nsswitch libc-rcmd libc-rtld-debug libc-spawn libc-streams libc-sunrpc \
					libc-utmp libc-utmpx libc-wordexp libc-posix-clang-wchar libc-posix-regexp libc-posix-regexp-glibc \
					libc-posix-wchar-io"
DISTRO_FEATURES_LIBC_virtclass-nativesdk = "${DISTRO_FEATURES_LIBC_DEFAULT}"

LIBRESWITCH_DEFAULT_DISTRO_FEATURES = " largefile multiarch systemd pam"

# We remove zeroconf from the distro features, otherwise we pull a big deal of dependencies for packagegroup-base
# We also remove bluetooth, wifi, nfs, 3g, because they are automatically pulled by packagegroup-base against your will...
DISTRO_FEATURES_DEFAULT = "alsa argp ext2 irda largefile pcmcia usbgadget usbhost xattr nfs pci audit"

DISTRO_FEATURES ?= "${DISTRO_FEATURES_DEFAULT} ${DISTRO_FEATURES_LIBC} ${LIBRESWITCH_DEFAULT_DISTRO_FEATURES}"

VIRTUAL-RUNTIME_init_manager = "systemd"
DISTRO_FEATURES_BACKFILL_CONSIDERED = "sysvinit"

IMAGE_LINGUAS ?= "en-us en-gb"
LIMIT_BUILT_LOCALES = "POSIX en_US"
ENABLE_BINARY_LOCALE_GENERATION ?= "0"

POKYQEMUDEPS = "${@bb.utils.contains("INCOMPATIBLE_LICENSE", "GPL-3.0", "", "packagegroup-core-device-devel",d)}"
DISTRO_EXTRA_RDEPENDS_append_qemuarm = " ${POKYQEMUDEPS}"
DISTRO_EXTRA_RDEPENDS_append_qemuarm64 = " ${POKYQEMUDEPS}"
DISTRO_EXTRA_RDEPENDS_append_qemumips = " ${POKYQEMUDEPS}"
DISTRO_EXTRA_RDEPENDS_append_qemuppc = " ${POKYQEMUDEPS}"
DISTRO_EXTRA_RDEPENDS_append_qemux86 = " ${POKYQEMUDEPS}"
DISTRO_EXTRA_RDEPENDS_append_qemux86-64 = " ${POKYQEMUDEPS}"

TCLIBCAPPEND = ""

QEMU_TARGETS ?= "arm aarch64 i386 mips mipsel mips64 ppc x86_64"
# Other QEMU_TARGETS "mips64el sh4"

PREMIRRORS ??= "\
bzr://.*/.*   http://downloads.yoctoproject.org/mirror/sources/ \n \
cvs://.*/.*   http://downloads.yoctoproject.org/mirror/sources/ \n \
git://.*/.*   http://downloads.yoctoproject.org/mirror/sources/ \n \
gitsm://.*/.* http://downloads.yoctoproject.org/mirror/sources/ \n \
hg://.*/.*    http://downloads.yoctoproject.org/mirror/sources/ \n \
osc://.*/.*   http://downloads.yoctoproject.org/mirror/sources/ \n \
p4://.*/.*    http://downloads.yoctoproject.org/mirror/sources/ \n \
svn://.*/.*   http://downloads.yoctoproject.org/mirror/sources/ \n"

MIRRORS =+ "\
ftp://.*/.*      http://downloads.yoctoproject.org/mirror/sources/ \n \
http://.*/.*     http://downloads.yoctoproject.org/mirror/sources/ \n \
https://.*/.*    http://downloads.yoctoproject.org/mirror/sources/ \n"

# The CONNECTIVITY_CHECK_URI's are used to test whether we can succesfully
# fetch from the network (and warn you if not). To disable the test set
# the variable to be empty.
# Git example url: git://git.yoctoproject.org/yocto-firewall-test;protocol=git;rev=master
CONNECTIVITY_CHECK_URIS ?= "https://www.example.com/"

SANITY_TESTED_DISTROS ?= " \
            poky-1.7 \n \
            poky-1.8 \n \
            poky-2.0 \n \
            Ubuntu-14.04 \n \
            Ubuntu-14.10 \n \
            Ubuntu-15.04 \n \
            Ubuntu-15.10 \n \
            Ubuntu-16.04 \n \
            Fedora-21 \n \
            Fedora-22 \n \
            Fedora-23 \n \
            CentOS-6.* \n \
            CentOS-7.* \n \
            Debian-7.* \n \
            Debian-8.* \n \
            openSUSE-project-13.2 \n \
            "

# Default hash policy for distro
BB_SIGNATURE_HANDLER ?= 'OEBasicHash'
#
# OELAYOUT_ABI allows us to notify users when the format of TMPDIR changes in 
# an incompatible way. Such changes should usually be detailed in the commit
# that breaks the format and have been previously discussed on the mailing list 
# with general agreement from the core team.
#
OELAYOUT_ABI = "11"

# add poky sanity bbclass
INHERIT += "poky-sanity"

# QA check settings - a little stricter than the OE-Core defaults
WARN_TO_ERROR_QA = "already-stripped compile-host-path install-host-path \
                    installed-vs-shipped ldflags pn-overrides rpaths staticdev \
                    useless-rpaths"
WARN_QA_remove = "${WARN_TO_ERROR_QA}"
ERROR_QA_append = " ${WARN_TO_ERROR_QA}"

require conf/distro/include/no-static-libs.inc
require conf/distro/include/libreswitch-uninative.inc
INHERIT += "uninative"
```

## yocto/libreswitch/meta-foss-libreswitch/conf/layer.conf
```bitbake
# We have a conf and classes directory, add to BBPATH
BBPATH := "${LAYERDIR}:${BBPATH}"

# We have a packages directory, add to BBFILES
BBFILES := "${BBFILES} ${LAYERDIR}/recipes-*/*/*.bb \
            ${LAYERDIR}/recipes-*/*/*.bbappend"

BBFILE_COLLECTIONS += "foss-libreswitch"
BBFILE_PATTERN_foss-libreswitch := "^${LAYERDIR}/"
BBFILE_PRIORITY_foss-libreswitch = "7"

LICENSE_PATH += "${LAYERDIR}/licenses"
```

## yocto/libreswitch/meta-platform-libreswitch-as5812t/conf/layer.conf
```bitbake
# We have a conf and classes directory, add to BBPATH
BBPATH := "${LAYERDIR}:${BBPATH}"

# We have a packages directory, add to BBFILES
BBFILES := "${BBFILES} ${LAYERDIR}/recipes-*/*/*.bb \
            ${LAYERDIR}/recipes-*/*/*.bbappend"

BBFILE_COLLECTIONS += "libreswitch-as5812t"
BBFILE_PATTERN_libreswitch-as5812t := "^${LAYERDIR}/"
BBFILE_PRIORITY_libreswitch-as5812t = "11"
```

## yocto/libreswitch/meta-platform-libreswitch-as5812x/conf/layer.conf
```bitbake
# We have a conf and classes directory, add to BBPATH
BBPATH := "${LAYERDIR}:${BBPATH}"

# We have a packages directory, add to BBFILES
BBFILES := "${BBFILES} ${LAYERDIR}/recipes-*/*/*.bb \
            ${LAYERDIR}/recipes-*/*/*.bbappend"

BBFILE_COLLECTIONS += "libreswitch-as5812x"
BBFILE_PATTERN_libreswitch-as5812x := "^${LAYERDIR}/"
BBFILE_PRIORITY_libreswitch-as5812x = "11"
```

## yocto/libreswitch/meta-platform-libreswitch-mlnx-sn2xxx/conf/machine/mlnx-sn2xxx.conf
```bitbake
# Copyright Mellanox Technologies, Ltd. 2001-2016.

DEFAULTTUNE ?= "core2-64"
require conf/machine/include/tune-core2.inc
include conf/machine/include/x86-base.inc

GLIBC_ADDONS = "nptl"

IMAGE_FSTYPES = "cpio.gz tar.gz"

MACHINE_FEATURES = "pcbios usbhost acpi pci ext2 ext3 x86 vfat serial ops-sai"
MACHINE_ESSENTIAL_EXTRA_RDEPENDS += " \
  packagegroup-ops-min \
  packagegroup-ops-min-debug \
  packagegroup-ops-base \
  packagegroup-ops-core \
"

# Allow login root with no password
EXTRA_IMAGE_FEATURES += "debug-tweaks"

PREFERRED_PROVIDER_virtual/ops-switchd-switch-api-plugin = "ops-switchd-sai-plugin"
PREFERRED_PROVIDER_virtual/sai = "sai-mlnx"

PREFERRED_VERSION_iproute2 = "3.19.0"

# Package contains python bindings to MLNX SX SDK library.
# Useful for debug purpose
MACHINE_EXTRA_RRECOMMENDS += "mlnx-python-sdk-api"

SX_SDK_VERSION ?= "4.2.2002"
SX_SDK_URI ?= "https://github.com/Mellanox/mellanox-openswitch/raw/master/sx-sdk/${SX_SDK_VERSION}/"

MLNX_HW_MGMT_VERSION ?= "25.05.16"
MLNX_HW_MGMT_URI ?= "https://github.com/Mellanox/mellanox-openswitch/raw/master/hw-mgmt/"

SAI_PLUGIN_BASE_URL ?= "${LBS_REPO_BASE_URL}"
SAI_PLUGIN_PROTOCOL ?= "${LBS_REPO_PROTOCOL}"
SAI_PLUGIN_BRANCH ?= "${LBS_REPO_BRANCH}"
```

## yocto/openhalon/meta-platform-as5712/conf/machine/as5712.conf
```bitbake
DEFAULTTUNE ?= "core2-64"
require conf/machine/include/tune-core2.inc
include conf/machine/include/x86-base.inc

PREFERRED_PROVIDER_virtual/kernel ?= "linux-halon"
PREFERRED_VERSION_linux-halon ?= "3.9%"

GLIBC_ADDONS = "nptl"

IMAGE_FSTYPES = "cpio.gz tar.gz"

MACHINE_FEATURES = "pcbios usbhost acpi serial pci ext2 ext3 x86 vfat"
MACHINE_ESSENTIAL_EXTRA_RDEPENDS += " \
  packagegroup-halon-min \
  packagegroup-halon-min-debug \
  packagegroup-halon-base \
"

# Enable ssh server and allow login root with no password
EXTRA_IMAGE_FEATURES ="debug-tweaks ssh-server-dropbear"

MACHINE_EXTRA_RRECOMMENDS += "dmidecode bcmsdk-drivers as5712-networking"
```
